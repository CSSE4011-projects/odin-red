## CMakeLists.txt
```
# SPDX-License-Identifier: Apache-2.0

cmake_minimum_required(VERSION 3.20.0)
find_package(Zephyr REQUIRED HINTS $ENV{ZEPHYR_BASE})
project(pos_base)

FILE(GLOB app_sources src/*.c)
target_sources(app PRIVATE ${app_sources})

zephyr_library_include_directories(${ZEPHYR_BASE}/samples/bluetooth)
target_sources_ifdef(CONFIG_SHELL_BACKEND_SERIAL app PRIVATE src/uart_reinit.c)
```

## Kconfig
```
# Copyright (c) 2019 Nordic Semiconductor ASA
# SPDX-License-Identifier: Apache-2.0

#config USB_DEVICE_PID
#	default USB_PID_CDC_ACM_SAMPLE

source "Kconfig.zephyr"
```

## prj.conf
```kconfig
CONFIG_BT=y
CONFIG_BT_CENTRAL=y
#CONFIG_BT_HOST_CCM=y
CONFIG_PRINTK=y
CONFIG_SHELL=y
CONFIG_LOG=y
CONFIG_INIT_STACKS=y
CONFIG_THREAD_STACK_INFO=y
CONFIG_KERNEL_SHELL=y
CONFIG_THREAD_MONITOR=y
CONFIG_BOOT_BANNER=n
CONFIG_THREAD_NAME=y
CONFIG_DEVICE_SHELL=y
CONFIG_EVENTS=y
CONFIG_LOG=y
CONFIG_POSIX_CLOCK=y
CONFIG_DATE_SHELL=y
CONFIG_THREAD_RUNTIME_STATS=y
CONFIG_THREAD_RUNTIME_STATS_USE_TIMING_FUNCTIONS=y
CONFIG_STATS=y
CONFIG_STATS_SHELL=y
CONFIG_CBPRINTF_FP_SUPPORT=y

CONFIG_USB_DEVICE_VID=0xCCCC
CONFIG_USB_DEVICE_PID=0x6969

CONFIG_SERIAL=y
CONFIG_UART_INTERRUPT_DRIVEN=y
CONFIG_CONSOLE=y
CONFIG_UART_CONSOLE=y
CONFIG_UART_LINE_CTRL=y

CONFIG_STDOUT_CONSOLE=y
CONFIG_USB_DEVICE_STACK=y
CONFIG_USB_DEVICE_PRODUCT="BSU USB Device"
CONFIG_USB_DRIVER_LOG_LEVEL_ERR=y
CONFIG_USB_DEVICE_LOG_LEVEL_ERR=y

CONFIG_USB_DEVICE_STACK=y
CONFIG_USB_DEVICE_PRODUCT="Zephyr USB console sample"

#CONFIG_BT_BROADCASTER=y
#CONFIG_BT_OBSERVER=y
CONFIG_BT_DEBUG_LOG=y
CONFIG_BT_SMP=y
CONFIG_BT_GATT_CLIENT=y

CONFIG_SYSTEM_WORKQUEUE_STACK_SIZE=2048


# Peripheral stuff:
CONFIG_BT=y
CONFIG_BT_SMP=y
#CONFIG_BT_SIGNING=y
#CONFIG_BT_PERIPHERAL=y
CONFIG_BT_DIS=y
#CONFIG_BT_ATT_PREPARE_COUNT=5
#CONFIG_BT_BAS=y
#CONFIG_BT_HRS=y
#CONFIG_BT_IAS=y
#CONFIG_BT_PRIVACY=y
CONFIG_BT_DEVICE_NAME="Zephyr Peripheral Sample Long Name"
CONFIG_BT_DEVICE_APPEARANCE=833
#CONFIG_BT_DEVICE_NAME_DYNAMIC=y
CONFIG_BT_DEVICE_NAME_MAX=65

CONFIG_HEAP_MEM_POOL_SIZE=1024

#CONFIG_BT_KEYS_OVERWRITE_OLDEST=y
#CONFIG_BT_SETTINGS=y
CONFIG_FLASH=y
CONFIG_FLASH_PAGE_LAYOUT=y
CONFIG_FLASH_MAP=y
CONFIG_NVS=y
CONFIG_SETTINGS=y

#CONFIG_BT_EXT_ADV=y
#CONFIG_BT_PER_ADV=y
```

## app.overlay
```dts
/ {
	chosen {
		zephyr,shell_uart = &cdc_acm_uart0;
		zephyr,console = &cdc_acm_uart0;
	};
};

&zephyr_udc0 {
	cdc_acm_uart0: cdc_acm_uart0 {
		compatible = "zephyr,cdc-acm-uart";
		label = "CDC_ACM_0";
	};
};
```

## src/main.c
```c
/* main.c - Application main entry point */

#include <zephyr/types.h>
#include <stddef.h>
#include <errno.h>
#include <zephyr/zephyr.h>
#include <zephyr/sys/printk.h>
#include <zephyr/kernel.h>
#include <version.h>
#include <zephyr/logging/log.h>
#include <stdlib.h>
#include <zephyr/drivers/uart.h>
#include <zephyr/usb/usb_device.h>
#include "pos_base_bt.h"
#include "pos_base_hci.h"


#include <ctype.h>
#include <stdio.h>

#ifdef CONFIG_ARCH_POSIX
#include <unistd.h>
#else
#include <zephyr/posix/unistd.h>
#endif


#define STACKSIZE 1024
#define PRIORITY 7
#define MSG_SIZE 32

K_MSGQ_DEFINE(uart_msgq, MSG_SIZE, 10, 4);

sys_slist_t node_list;
struct k_event sens;
static struct Data data = {&uart_msgq, &sens, &node_list};


void thread1(void) {
	bt_th(&data);
}

void thread2(void) {
	bt_read();
}

void thread3(void) {
	hci_th(&data);
}



K_THREAD_DEFINE(t1, STACKSIZE, thread1, NULL, NULL, NULL,
		PRIORITY, 0, 0);
K_THREAD_DEFINE(t2, STACKSIZE, thread2, NULL, NULL, NULL,
		PRIORITY, 0, 0);
K_THREAD_DEFINE(t3, STACKSIZE * 3, thread3, NULL, NULL, NULL,
		PRIORITY, 0, 0);
```

## src/pos_base_bt.c
```c
/*
* Driver for Base node bluetooth
*/

#include "pos_base_bt.h"

LOG_MODULE_REGISTER(bt);

/* Initialising message queue for control data */
K_MSGQ_DEFINE(
    control_msgq,
    sizeof(struct control_data),
    CONTROL_MSGQ_MAX_MSG,
    CONTROL_MSGQ_ALIGN
);

/* Semaphore to signal refernce angle updates */
K_SEM_DEFINE(update_ref_angle_sem, 0, 1);

struct k_msgq *bt_queue;
struct k_event *bt_ev;
struct k_event data_ev;
bool get_node_params;
sys_slist_t* bt_list;
bool ble_connected;

#define UUID_BUFFER_SIZE 16

static void start_scan(void);

uint8_t current_pos[] = {0, 0};
uint8_t cont_data[] = {0, 0, 90};

static struct bt_conn *default_conn;

uint16_t mobile_uuid[] = {0xd0, 0x92, 0x67, 0x35, 0x78, 0x16, 0x21, 0x91,
                          0x26, 0x49, 0x60, 0xeb, 0x06, 0xa7, 0xca, 0xcb};

uint16_t base_uuid[] = {0xd0, 0x92, 0x27, 0x35, 0x78, 0x16, 0x21, 0x91,
                          0x26, 0x49, 0x60, 0xeb, 0x06, 0xa3, 0xca, 0x2b};

static struct bt_uuid_128 cont_uuid = BT_UUID_INIT_128(
    0xd8, 0x92, 0x67, 0x35, 0x78, 0x16, 0xa1, 0x91,
    0x26, 0x29, 0x60, 0xeb, 0x46, 0xa7, 0xca, 0xcb);

static struct bt_uuid_128 pos_uuid = BT_UUID_INIT_128(
    0xd8, 0x92, 0x67, 0x35, 0x78, 0x16, 0x21, 0x91,
    0x26, 0x49, 0x60, 0xeb, 0x06, 0xa7, 0xca, 0xcb);

static struct bt_uuid_128 angle_uuid = BT_UUID_INIT_128(
    0xd8, 0x92, 0x67, 0x35, 0x50, 0x16, 0x21, 0x91,
    0x26, 0x49, 0x06, 0xeb, 0x06, 0xa7, 0x23, 0xcb);


static bool check_dev(struct bt_data *data, void *user_data)
{
	bt_addr_le_t *addr = user_data;
    int i;
    int matchedCount = 0;

    if (data->type == BT_DATA_UUID128_ALL)
    {

        uint16_t temp = 0;
        for (i = 0; i < data->data_len; i++)
        {
            temp = data->data[i];
            if (temp == mobile_uuid[i])
                matchedCount++;
        }

        if (matchedCount == UUID_BUFFER_SIZE)
        {
            //MOBILE UUID MATCHED
            LOG_INF("Mobile UUID Found, attempting to connect\n");

            int err = bt_le_scan_stop();
            k_msleep(10);

            if (err)
            {
                LOG_INF("Stop LE scan failed (err %d)\n", err);
                return true;
            }

            struct bt_le_conn_param *param = BT_LE_CONN_PARAM_DEFAULT;

            err = bt_conn_le_create(addr, BT_CONN_LE_CREATE_CONN,
                                    param, &default_conn);
            if (err)
            {
                LOG_INF("Create conn failed (err %d)\n", err);
                start_scan();
            }

            return false;
        }
    }
    return true;
}

static ssize_t give_cont(struct bt_conn *conn,
                          const struct bt_gatt_attr *attr, void *buf,
                          uint16_t len, uint16_t offset)
{
    const int16_t *value = attr->user_data;
    return bt_gatt_attr_read(conn, attr, buf, len, offset, value, sizeof(cont_data));
}

static void device_found(const bt_addr_le_t *addr, int8_t rssi, uint8_t type,
                         struct net_buf_simple *ad)
{
	if (type == BT_GAP_ADV_TYPE_ADV_IND ||
        type == BT_GAP_ADV_TYPE_ADV_DIRECT_IND)
    {
        bt_data_parse(ad, check_dev, (void *)addr);
    }
}

uint8_t read_pos(struct bt_conn *conn, uint8_t err,
                               struct bt_gatt_read_params *params,
                               const void *data, uint16_t length)
{
    memcpy(current_pos, data, 2);
    return 0;
}

uint8_t update_angle(struct bt_conn *conn, uint8_t err,
                               struct bt_gatt_read_params *params,
                               const void *data, uint16_t length)
{
    return 0;
}


BT_GATT_SERVICE_DEFINE(base_svc,
                       BT_GATT_PRIMARY_SERVICE(&base_uuid),
                       
                       BT_GATT_CHARACTERISTIC(&cont_uuid.uuid,
                                              BT_GATT_CHRC_READ,
                                              BT_GATT_PERM_READ,
                                              give_cont, NULL, &cont_data),  );

static void start_scan(void)
{
	int err;

	err = bt_le_scan_start(BT_LE_SCAN_PASSIVE, device_found);
	if (err) {
		LOG_INF("Scanning failed to start (err %d)\n", err);
		return;
	}

	LOG_INF("Scanning successfully started\n");
}

static void connected(struct bt_conn *conn, uint8_t err)
{
	char addr[BT_ADDR_LE_STR_LEN];

    bt_addr_le_to_str(bt_conn_get_dst(conn), addr, sizeof(addr));

    if (err)
    {
        LOG_INF("Failed to connect to %s (%u)\n", addr, err);

        bt_conn_unref(default_conn);
        default_conn = NULL;

        start_scan();
        return;
    }

    if (conn != default_conn)
    {
        return;
    }
    ble_connected = true;
    LOG_INF("Connected: %s\n", addr);
}

static void disconnected(struct bt_conn *conn, uint8_t reason)
{
	char addr[BT_ADDR_LE_STR_LEN];

    if (conn != default_conn)
        return;

    bt_addr_le_to_str(bt_conn_get_dst(conn), addr, sizeof(addr));

    LOG_INF("Disconnected: %s (reason 0x%02x)\n", addr, reason);

    bt_conn_unref(default_conn);
    default_conn = NULL;
    ble_connected = false;
    start_scan();
}

BT_CONN_CB_DEFINE(conn_callbacks) = {
	.connected = connected,
	.disconnected = disconnected,
};

void bt_read(void)
{
    static struct bt_gatt_read_params read_pos_params = {
        .func = read_pos,
        .handle_count = 0,
        .by_uuid.uuid = &pos_uuid.uuid,
        .by_uuid.start_handle = BT_ATT_FIRST_ATTRIBUTE_HANDLE,
        .by_uuid.end_handle = BT_ATT_LAST_ATTRIBUTE_HANDLE,
    };

    static struct bt_gatt_read_params update_angle_params = {
        .func = update_angle,
        .handle_count = 0,
        .by_uuid.uuid = &angle_uuid.uuid,
        .by_uuid.start_handle = BT_ATT_FIRST_ATTRIBUTE_HANDLE,
        .by_uuid.end_handle = BT_ATT_LAST_ATTRIBUTE_HANDLE,
    };

    k_msleep(1000);

    struct control_data control;

	uint32_t prev_time = k_uptime_get_32();
	uint32_t current_time;

    while (1)
    {
        if (ble_connected)
        {
            // Check for updated pos from main
            while (!k_msgq_get(&control_msgq, &control, K_NO_WAIT)) {
                cont_data[0] = control.pedal_left;
                cont_data[1] = control.pedal_right;
                cont_data[2] = control.rudder_angle;
            }

            /* Check if update reference angle semaphore has been given */
            if (!k_sem_take(&update_ref_angle_sem, K_NO_WAIT)) {
                /* Trigger an update of the reference angle over bt */
                bt_gatt_read(default_conn, &update_angle_params);
            }

            current_time = k_uptime_get_32();
            if (current_time - prev_time > 200) {
                bt_gatt_read(default_conn, &read_pos_params);
                printk("{%d, %d}\n", current_pos[0], current_pos[1]);
                prev_time = current_time;
            }

        }
        k_msleep(50);
    }

}


void bt_th(struct Data * input)
{

    sys_slist_init(input->n_list);
    bt_list = input->n_list;
	bt_queue = input->msgq;
    bt_ev = input->event;

	int err;

	err = bt_enable(NULL);
	if (err) {
		LOG_INF("Bluetooth init failed (err %d)\n", err);
		return;
	}

    settings_load();

    start_scan();

    while (1) {
        k_sleep(K_MSEC(500));
    }
}
```

## src/pos_base_bt.h
```c
#ifndef BSU_BT_H
#define BSU_BT_H

#include <zephyr/types.h>
#include <stddef.h>
#include <errno.h>
#include <zephyr/zephyr.h>
#include <zephyr/sys/printk.h>

#include <zephyr/bluetooth/bluetooth.h>
#include <zephyr/bluetooth/hci.h>
#include <zephyr/bluetooth/conn.h>
#include <zephyr/bluetooth/uuid.h>
#include <zephyr/bluetooth/gatt.h>
#include <zephyr/sys/byteorder.h>

#include <zephyr/types.h>
#include <stddef.h>
#include <errno.h>
#include <zephyr/zephyr.h>
#include <zephyr/sys/printk.h>
#include <zephyr/kernel.h>
#include <version.h>
#include <zephyr/logging/log.h>
#include <stdlib.h>
#include <zephyr/drivers/uart.h>
#include <zephyr/usb/usb_device.h>
#include "pos_base_hci.h"

/* Macro definitions for control message queue */
#define CONTROL_MSGQ_MAX_MSG 20
#define CONTROL_MSGQ_ALIGN 4

void bt_th(struct Data*);
void bt_read(void);

/* Message queue for control data */
extern struct k_msgq control_msgq;

/* Struct for control data */
struct control_data {
    uint8_t pedal_left;
    uint8_t pedal_right;
    uint8_t rudder_angle;
};

/* Semaphore for signalling reference angle updates */
extern struct k_sem update_ref_angle_sem;

#endif
```

## src/pos_base_hci.c
```c
/*
* Driver for BSU HCI
*/

#include <zephyr/shell/shell.h>
#include <zephyr/drivers/uart.h>
#include "pos_base_hci.h"
#include "pos_base_bt.h"

struct k_msgq * hci_queue;
struct k_event *hci_ev;

sys_slist_t* hci_list;

int period;

static int64_t time_stamp;
LOG_MODULE_REGISTER(app);

struct k_heap node_heap;
K_HEAP_DEFINE(node_heap, sizeof(uint8_t) * 100);

BUILD_ASSERT(DT_NODE_HAS_COMPAT(DT_CHOSEN(zephyr_shell_uart), zephyr_cdc_acm_uart),
	     "Console device is not ACM CDC UART device");

static int cmd_pedal(const struct shell *shell, size_t argc, char **argv)
{
	/* Send control data to bt */
	struct control_data pedal_data;
	pedal_data.pedal_left = atoi(argv[1]);
	pedal_data.pedal_right = atoi(argv[2]);
	pedal_data.rudder_angle = atoi(argv[3]);
	if (k_msgq_put(&control_msgq, &pedal_data, K_NO_WAIT) != 0) {
		/* Queue is full, purge it */
		k_msgq_purge(&control_msgq);
	}
	
	return 0;
}

static int cmd_angle(const struct shell *shell, size_t argc, char **argv)
{
	/* Give semaphore to update angle */
    k_sem_give(&update_ref_angle_sem);
	
	return 0;
}

SHELL_CMD_ARG_REGISTER(pedal, NULL, "Pedal data received", cmd_pedal, 0, 3);
SHELL_CMD_ARG_REGISTER(angle, NULL, "Update reference angle", cmd_angle, 0, 0);

void hci_th(struct Data * input)
{
	//k_heap_init(node_heap, pointer, sizeof(uint8_t) * 100);
	hci_queue = input->msgq;
	hci_ev = input->event;
	hci_list = input->n_list;
	const struct device *dev;
	uint32_t baudrate, dtr = 0U;
	int ret;
	period = 1;

	dev = DEVICE_DT_GET(DT_CHOSEN(zephyr_shell_uart));

	time_stamp = k_uptime_get();

	if (!device_is_ready(dev) || usb_enable(NULL)) {
		return;
	}

	while (!dtr) {
		uart_line_ctrl_get(dev, UART_LINE_CTRL_DTR, &dtr);
		k_sleep(K_MSEC(100));
	}

	/* They are optional, we use them to test the interrupt endpoint */
	ret = uart_line_ctrl_set(dev, UART_LINE_CTRL_DCD, 1);
	if (ret) {
		LOG_WRN("Failed to set DCD, ret code %d", ret);
	}

	ret = uart_line_ctrl_set(dev, UART_LINE_CTRL_DSR, 1);
	if (ret) {
		LOG_WRN("Failed to set DSR, ret code %d", ret);
	}

	ret = uart_line_ctrl_get(dev, UART_LINE_CTRL_BAUD_RATE, &baudrate);
	if (ret) {
		LOG_WRN("Failed to get baudrate, ret code %d", ret);
	} else {
		LOG_INF("Baudrate detected: %d", baudrate);
	}

	uint32_t events = 0;

	while (1) {
		k_msleep(100);
	}
}
```

## src/pos_base_hci.h
```c
#ifndef BSU_HCI_H
#define BSU_HCI_H

#include <stdio.h>
#include <string.h>
#include <stdint.h>

#include <zephyr/types.h>
#include <stddef.h>
#include <errno.h>
#include <zephyr/zephyr.h>
#include <zephyr/sys/printk.h>
#include <zephyr/kernel.h>
#include <version.h>
#include <zephyr/logging/log.h>
#include <stdlib.h>
#include <zephyr/drivers/uart.h>
#include <zephyr/usb/usb_device.h>

struct Data {
	struct k_msgq * msgq;
	struct k_event * event;
	sys_slist_t* n_list;
};

struct Element {
	sys_snode_t* el_node;
	char el_name[10];
	uint8_t el_mac[6];
	uint16_t el_maj;
	uint16_t el_min;
	uint8_t el_x;
	uint8_t el_y;
	char* el_left;
	char* el_right;
};

void hci_th(struct Data*);
void shell_rc(void);

#endif
```

## src/uart_reinit.c
```c
/*
 * Copyright (c) 2021 Nordic Semiconductor ASA
 *
 * SPDX-License-Identifier: Apache-2.0
 */
#include <zephyr/shell/shell.h>
#include <zephyr/shell/shell_uart.h>
#include <zephyr/drivers/uart.h>
#include <zephyr/device.h>

void shell_init_from_work(struct k_work *work)
{
	const struct device *dev = DEVICE_DT_GET(DT_CHOSEN(zephyr_console));
	bool log_backend = CONFIG_SHELL_BACKEND_SERIAL_LOG_LEVEL > 0;
	uint32_t level =
		(CONFIG_SHELL_BACKEND_SERIAL_LOG_LEVEL > LOG_LEVEL_DBG) ?
		CONFIG_LOG_MAX_LEVEL : CONFIG_SHELL_BACKEND_SERIAL_LOG_LEVEL;

	shell_init(shell_backend_uart_get_ptr(), dev,
		   shell_backend_uart_get_ptr()->ctx->cfg.flags,
		   log_backend, level);
}

static void shell_reinit_trigger(void)
{
	static struct k_work shell_init_work;

	k_work_init(&shell_init_work, shell_init_from_work);
	int err = k_work_submit(&shell_init_work);

	(void)err;
	__ASSERT_NO_MSG(err >= 0);
}

static void direct_uart_callback(const struct device *dev, void *user_data)
{
	static uint8_t buf[1];
	static bool tx_busy;

	uart_irq_update(dev);


	if (uart_irq_rx_ready(dev)) {
		while (uart_fifo_read(dev, buf, sizeof(buf))) {
			if (!tx_busy) {
				uart_irq_tx_enable(dev);
			}
		}
	}

	if (uart_irq_tx_ready(dev)) {
		if (!tx_busy) {
			(void)uart_fifo_fill(dev, buf, sizeof(buf));
			tx_busy = true;
		} else {
			tx_busy = false;
			uart_irq_tx_disable(dev);
			if (buf[0] == 'x') {
				uart_irq_rx_disable(dev);
				shell_reinit_trigger();
			}
		}
	}
}

static void uart_poll_timer_stopped(struct k_timer *timer)
{
	shell_reinit_trigger();
}

static void uart_poll_timeout(struct k_timer *timer)
{
	char c;
	const struct device *dev = k_timer_user_data_get(timer);

	while (uart_poll_in(dev, &c) == 0) {
		if (c != 'x') {
			uart_poll_out(dev, c);
		} else {
			k_timer_stop(timer);
		}
	}
}

K_TIMER_DEFINE(uart_poll_timer, uart_poll_timeout, uart_poll_timer_stopped);

static void shell_uninit_cb(const struct shell *shell, int res)
{
	__ASSERT_NO_MSG(res >= 0);
	const struct device *dev = DEVICE_DT_GET(DT_CHOSEN(zephyr_console));

	if (IS_ENABLED(CONFIG_SHELL_BACKEND_SERIAL_INTERRUPT_DRIVEN)) {
		/* connect uart to my handler */
		uart_irq_callback_user_data_set(dev, direct_uart_callback, NULL);
		uart_irq_rx_enable(dev);
	} else {
		k_timer_user_data_set(&uart_poll_timer, (void *)dev);
		k_timer_start(&uart_poll_timer, K_MSEC(10), K_MSEC(10));
	}
}

static int cmd_uart_release(const struct shell *shell, size_t argc, char **argv)
{
	ARG_UNUSED(argc);
	ARG_UNUSED(argv);

	if (shell != shell_backend_uart_get_ptr()) {
		shell_error(shell, "Command dedicated for shell over uart");
		return -EINVAL;
	}

	shell_print(shell, "Uninitializing shell, use 'x' to reinitialize");
	shell_uninit(shell, shell_uninit_cb);

	return 0;
}

SHELL_CMD_REGISTER(shell_uart_release, NULL,
		"Uninitialize shell instance and release uart, start loopback "
		"on uart. Shell instance is reinitialized when 'x' is pressed",
		cmd_uart_release);
```
